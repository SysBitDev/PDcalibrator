## main/Kconfig.projbuild
```kconfig
menu "Display Configuration"

    config I2C_MASTER_SCL_IO
        int "I2C Master SCL IO"
        default 9
        help
            GPIO number for the I2C master clock line (SCL).
    
    config I2C_MASTER_SDA_IO
        int "I2C Master SDA IO"
        default 8
        help
            GPIO number for the I2C master data line (SDA).
    
    config I2C_MASTER_NUM
        int "I2C Master Port Number"
        default 0
        help
            I2C port number to be used for the I2C master.
    
    config I2C_MASTER_FREQ_HZ
        int "I2C Master Frequency (Hz)"
        default 400000
        help
            Frequency of the I2C master clock in Hertz.
    
    config I2C_MASTER_TIMEOUT_MS
        int "I2C Master Timeout (ms)"
        default 1000
        help
            Timeout for I2C operations in milliseconds.
    
    config GPIO_TOUCH_RESET
        int "GPIO Number for Touch Reset"
        default 4
        help
            GPIO number used to reset the touch controller.
    
    config LCD_PIXEL_CLOCK_HZ
        int "LCD Pixel Clock (Hz)"
        default 18000000
        help
            Pixel clock frequency for the LCD in Hertz.
    
    config LCD_BK_LIGHT_ON_LEVEL
        int "LCD Backlight ON Level"
        default 1
        help
            Logical level to turn the LCD backlight ON.
    
    config PIN_NUM_BK_LIGHT
        int "GPIO Number for Backlight"
        default -1
        help
            GPIO number for controlling the LCD backlight. Set to -1 if not used.
    
    config PIN_NUM_HSYNC
        int "GPIO Number for HSYNC"
        default 46
        help
            GPIO number for the horizontal synchronization signal (HSYNC).
    
    config PIN_NUM_VSYNC
        int "GPIO Number for VSYNC"
        default 3
        help
            GPIO number for the vertical synchronization signal (VSYNC).
    
    config PIN_NUM_DE
        int "GPIO Number for DE"
        default 5
        help
            GPIO number for the Data Enable signal (DE).
    
    config PIN_NUM_PCLK
        int "GPIO Number for PCLK"
        default 7
        help
            GPIO number for the pixel clock signal (PCLK).
    
    config PIN_NUM_DATA0
        int "GPIO Number for DATA0"
        default 14
        help
            GPIO number for LCD data line 0.
    
    config PIN_NUM_DATA1
        int "GPIO Number for DATA1"
        default 38
        help
            GPIO number for LCD data line 1.
    
    config PIN_NUM_DATA2
        int "GPIO Number for DATA2"
        default 18
        help
            GPIO number for LCD data line 2.
    
    config PIN_NUM_DATA3
        int "GPIO Number for DATA3"
        default 17
        help
            GPIO number for LCD data line 3.
    
    config PIN_NUM_DATA4
        int "GPIO Number for DATA4"
        default 10
        help
            GPIO number for LCD data line 4.
    
    config PIN_NUM_DATA5
        int "GPIO Number for DATA5"
        default 39
        help
            GPIO number for LCD data line 5.
    
    config PIN_NUM_DATA6
        int "GPIO Number for DATA6"
        default 0
        help
            GPIO number for LCD data line 6.
    
    config PIN_NUM_DATA7
        int "GPIO Number for DATA7"
        default 45
        help
            GPIO number for LCD data line 7.
    
    config PIN_NUM_DATA8
        int "GPIO Number for DATA8"
        default 48
        help
            GPIO number for LCD data line 8.
    
    config PIN_NUM_DATA9
        int "GPIO Number for DATA9"
        default 47
        help
            GPIO number for LCD data line 9.
    
    config PIN_NUM_DATA10
        int "GPIO Number for DATA10"
        default 21
        help
            GPIO number for LCD data line 10.
    
    config PIN_NUM_DATA11
        int "GPIO Number for DATA11"
        default 1
        help
            GPIO number for LCD data line 11.
    
    config PIN_NUM_DATA12
        int "GPIO Number for DATA12"
        default 2
        help
            GPIO number for LCD data line 12.
    
    config PIN_NUM_DATA13
        int "GPIO Number for DATA13"
        default 42
        help
            GPIO number for LCD data line 13.
    
    config PIN_NUM_DATA14
        int "GPIO Number for DATA14"
        default 41
        help
            GPIO number for LCD data line 14.
    
    config PIN_NUM_DATA15
        int "GPIO Number for DATA15"
        default 40
        help
            GPIO number for LCD data line 15.
    
    config PIN_NUM_DISP_EN
        int "GPIO Number for Display Enable"
        default -1
        help
            GPIO number to enable or disable the display. Set to -1 if not used.
    
    config LCD_H_RES
        int "LCD Horizontal Resolution"
        default 800
        help
            Horizontal resolution of the LCD in pixels.
    
    config LCD_V_RES
        int "LCD Vertical Resolution"
        default 480
        help
            Vertical resolution of the LCD in pixels.
    
    config LVGL_TICK_PERIOD_MS
        int "LVGL Tick Period (ms)"
        default 2
        help
            Period for the LVGL tick increment in milliseconds.
    
    config LVGL_TASK_STACK_SIZE
        int "LVGL Task Stack Size (bytes)"
        default 4096
        help
            Stack size for the LVGL task in bytes.
    
    config LVGL_TASK_PRIORITY
        int "LVGL Task Priority"
        default 2
        help
            Priority of the LVGL task.
    
    endmenu
    
    menu "Example Configuration"
    
    config EXAMPLE_DOUBLE_FB
        bool "Use double Frame Buffer"
        default n
        help
            Enable this option to allocate two frame buffers for double buffering.
    
    config EXAMPLE_USE_BOUNCE_BUFFER
        depends on !EXAMPLE_DOUBLE_FB
        bool "Use bounce buffer"
        help
            Enable bounce buffer mode to achieve higher PCLK frequency at the cost of higher CPU consumption.
    
    config EXAMPLE_AVOID_TEAR_EFFECT_WITH_SEM
        depends on !EXAMPLE_DOUBLE_FB
        bool "Avoid tearing effect"
        default y
        help
            Enable this option to use semaphores to avoid tearing effects.
            Note: If Double Frame Buffer is used, tearing effect can be avoided without locks.
    
    endmenu
    
```
