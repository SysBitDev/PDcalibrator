#include "fd_dsp.h"
#include "board.h"
#include "_dsp.h"
#include "_misc.h"
//#include "_filter.h"
#include "_debug.h"
//#include "modRandom.h"
#include "math.h"

// TODO рекалибровку частоты и где-то таблица делится на два?

// Frequencies recommended is 697.0, 770.0, 852.0, 941.0, 1209.0, 1336.0, 1477.0, 1633.0
#if DSP_FD_CODE_RAM
static FLOAT frq[ 4 ] = { 1209.0f, 941.0f, 770.0f, 852.0f }; //DSP_FD_FRQ_NUM  197
#endif


#if DSP_FD_CODE_RAM
S16 gsin_buf[ DSP_FD_FRQ_NUM ][ DSP_FD_BUF_SIZE ];
#else
static const S16 gsin_buf[ DSP_FD_FRQ_NUM ][ 1000 ] = {
{
0, 481, 935, 1337, 1664, 1898, 2025, 2038, 1937, 1728,
1421, 1035, 591, 113, -370, -833, -1249, -1595, -1852, -2005,
-2045, -1971, -1786, -1501, -1131, -699, -227, 257, 728, 1157,
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1167, 738, 269, -215, -688, -1122, -1493, -1780, -1968, -2045,
},{
0, 376, 739, 1077, 1378, 1633, 1832, 1968, 2038, 2038,
1969, 1832, 1634, 1379, 1078, 740, 377, 1, -374, -738,
-1076, -1377, -1632, -1831, -1968, -2038, -2038, -1969, -1833, -1634,
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1326, 1590, 1799, 1948, 2030, 2043, 1987, 1862, 1675, 1430,
}
};
#endif

#if DSP_FD_CODE_RAM
S16 gcos_buf[ DSP_FD_FRQ_NUM ][ DSP_FD_BUF_SIZE ];
#else
static const S16 gcos_buf[ DSP_FD_FRQ_NUM ][ 1000 ] = {
{
2047, 1989, 1820, 1549, 1191, 766, 298, -185, -660, -1097,
-1472, -1765, -1959, -2043, -2013, -1869, -1621, -1282, -870, -410,
72, 551, 999, 1391, 1705, 1923, 2034, 2030, 1913, 1688,
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-1681, -1908, -2029, -2035, -1927, -1712, -1400, -1009, -562, -83,
},{
2047, 2012, 1908, 1740, 1512, 1233, 912, 560, 189, -188,
-559, -911, -1232, -1512, -1739, -1908, -2011, -2046, -2012, -1909,
-1741, -1513, -1234, -913, -561, -190, 187, 558, 910, 1231,
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1559, 1288, 974, 627, 258, -118, -491, -848, -1176, -1464,
}
};
#endif







//#define HEY

#ifdef HEY

#pragma GCC push_options
//#pragma GCC optimize ("03") // ("-Ofast")

#define EQUALS(a, b)	assert((a) == (b))
#define CLOSE(a, b)							\
	assert(								\
		fabs(static_cast<float>(a) -				\
		     static_cast<float>(b))	<=			\
		   fabs((2 * a.epsilon * static_cast<float>(a)))	\
	)

#include <limits>
template<typename Q_BASE, typename Q_DOUBLE, int Q_FACT>
class QFixed_ {
	Q_BASE a;

	static constexpr Q_DOUBLE Q_MAX = std::numeric_limits<Q_BASE>::max();
	static constexpr Q_DOUBLE Q_MIN = std::numeric_limits<Q_BASE>::min();
	static constexpr Q_DOUBLE K = (1 << (Q_FACT - 1));
	static constexpr float DIV = (1 << Q_FACT);

	typedef QFixed_<Q_BASE, Q_DOUBLE, Q_FACT> MY_TYPE;

	static Q_BASE saturateRaw(Q_DOUBLE x) {
		if (x > Q_MAX)
			return Q_MAX;
		else if (x < Q_MIN)
			return Q_MIN;
		else
			return x;
	}

	static MY_TYPE saturate(Q_DOUBLE x) {
		return from_raw(saturateRaw(x));
	}

public:
	typedef Q_BASE base_type;
	typedef Q_DOUBLE double_base_type;

	static constexpr float epsilon = 1./(1 << Q_FACT);

	QFixed_(float a_ = 0) : a(saturateRaw(a_ * DIV)) {}

	static MY_TYPE from_float(float a) {
		return MY_TYPE(a);
	}

	static MY_TYPE from_raw(Q_BASE a) {
		MY_TYPE r;
		r.a = a;
		return r;
	}

	static MY_TYPE from_Q_DOUBLE(Q_DOUBLE a) {
		return saturate(a << Q_FACT);
	}

	operator float() const {
#ifdef DEBUG_OPS
		std::cout << *this << " float" << std::endl;
#endif
		return static_cast<float>(a) / DIV;
	}

	MY_TYPE operator +(const MY_TYPE &other) {
#ifdef DEBUG_OPS
		std::cout << *this << " + " << other << std::endl;
#endif
		return saturate((Q_DOUBLE)a + (Q_DOUBLE)other.a);
	}

	MY_TYPE operator -(const MY_TYPE &other) {
#ifdef DEBUG_OPS
		std::cout << *this << " - " << other << std::endl;
#endif
		return from_raw(a - other.a);
	}

	MY_TYPE operator *(const MY_TYPE &other) {
		Q_DOUBLE temp;

		temp = (Q_DOUBLE)a * (Q_DOUBLE)other.a;

#ifdef DEBUG_OPS
		std::cout << *this << " * " << other << std::endl;
#endif

		// round up
		temp += K;


		// Correct by dividing by base and saturate result
		return saturate(temp >> Q_FACT);
	}

	/* FIXME(pboldin): these maybe slower than ideal */
	MY_TYPE &operator *=(const MY_TYPE &other) {
#ifdef DEBUG_OPS
		std::cout << *this << " *= " << other << std::endl;
#endif
		*this = (*this * other);
		return *this;
	}

	MY_TYPE &operator +=(const MY_TYPE &other) {
#ifdef DEBUG_OPS
		std::cout << *this << " += " << other << std::endl;
#endif
		*this = *this + other;
		return *this;
	}

	MY_TYPE &operator -=(const MY_TYPE &other) {
#ifdef DEBUG_OPS
		std::cout << *this << " -= " << other << std::endl;
#endif
		*this = *this - other;
		return *this;
	}

	bool operator ==(const MY_TYPE &other) {
		return a == other.a;
	}

	bool operator ==(const int &other) {
		return a == (other << Q_FACT);
	}

	friend MY_TYPE exp(const MY_TYPE &my) {
		return MY_TYPE::from_float(exp(static_cast<float>(my)));
	}

	friend MY_TYPE sin(const MY_TYPE &my) {
		return MY_TYPE::from_float(sin(static_cast<float>(my)));
	}

	friend MY_TYPE cos(const MY_TYPE &my) {
		return MY_TYPE::from_float(cos(static_cast<float>(my)));
	}

#ifdef OSTREAM
	friend std::ostream &operator <<(std::ostream &os, const MY_TYPE &qf) {
		os << "{ a = " << qf.a << " }";
		return os;
	}
#endif
};
typedef QFixed_<int32_t, int64_t, 20> QFixed;

void test_qfixed()
{
	QFixed q = 10, p = 20, o = QFixed::from_float(1.5);

	EQUALS(q + p, 30);
	EQUALS(q * p, 200);
	EQUALS(p * o, 30);
	EQUALS(o * o, QFixed::from_float(2.25));
	EQUALS(q - p, -10);

	q *= p;
	EQUALS(q, 200);
	p *= o;
	EQUALS(p, 30);

	QFixed pisquare_1 = QFixed::from_float(M_PI) * QFixed::from_float(M_PI);
	QFixed pisquare_2 = QFixed::from_float(M_PI * M_PI);
	CLOSE(pisquare_1, pisquare_2);

	CLOSE(QFixed::from_float(M_PI / 2.), M_PI / 2.);

	CLOSE(exp(QFixed::from_float(-1)), QFixed::from_float(exp(-1)));
	CLOSE(sin(QFixed::from_float(M_PI / 2.)), QFixed::from_float(1.));

	{
		QFixed q = QFixed::from_raw(1483322);
		assert((q * q) > 0);
	}
}

#pragma GCC pop_options

#endif /* HEY */

#if GOERTZEL_v3

/*
 * Sliding Windowed Infinite Fourier Transform (SWIFT) in Q-format
 *
 * 2023 (c) Pavel Boldin <pavel.b@techspark.engineering>
 *
 * Compile with make. Add make CFLAGS=-DASWIFT for alpha-SWIFT implementation
 */


float FREQ = frq[ 0 ] / DSP_FD_SAMPLING_RATE;
const float TAU = 500;
const float TAU_fast = 10;

#define Q	8
#define QQ	(1 << Q)

#define Q_BASE		int32_t
#define Q_DOUBLE	int64_t
#define Q_MIN		INT32_MIN
#define Q_MAX		INT32_MAX

/* https://en.wikipedia.org/wiki/Q_%28number_format%29 */
Q_BASE q_add(Q_BASE a, Q_BASE b)
{
	Q_BASE result;
	Q_DOUBLE tmp;

	tmp = (Q_DOUBLE)a + (Q_DOUBLE)b;
	if (tmp > Q_MAX)
		tmp = Q_MAX;
	if (tmp < Q_MIN)
		tmp = Q_MIN;
	result = (Q_BASE)tmp;

	return result;
}

Q_BASE q_sub(Q_BASE a, Q_BASE b)
{
	return a - b;
}

// precomputed value:
#define K   (1 << (Q - 1))

// saturate to range of Q_BASE
Q_BASE satQ(Q_DOUBLE x)
{
	if (x > Q_MAX) return Q_MAX;
	else if (x < Q_MIN) return Q_MIN;
	else return (Q_BASE)x;
}

Q_BASE q_mul(Q_BASE a, Q_BASE b)
{
	Q_BASE result;
	Q_DOUBLE temp;

	temp = (Q_DOUBLE)a * (Q_DOUBLE)b; // result type is operand's type
					// Rounding; mid values are rounded up
	temp += K;
	// Correct by dividing by base and saturate result
	result = satQ(temp >> Q);

	return result;
}

void q_mul_complex(Q_BASE a_i, Q_BASE a_q,
		Q_BASE b_i, Q_BASE b_q,
		Q_BASE *c_i, Q_BASE *c_q)
{
	*c_i = q_sub(q_mul(a_i, b_i), q_mul(a_q, b_q));
	*c_q = q_add(q_mul(a_i, b_q), q_mul(a_q, b_i));
}

void q_add_complex(Q_BASE a_i, Q_BASE a_q,
		Q_BASE b_i, Q_BASE b_q,
		Q_BASE *c_i, Q_BASE *c_q)
{
	*c_i = q_add(a_i, b_i);
	*c_q = q_add(a_q, b_q);
}

void q_sub_complex(Q_BASE a_i, Q_BASE a_q,
		Q_BASE b_i, Q_BASE b_q,
		Q_BASE *c_i, Q_BASE *c_q)
{
	*c_i = q_sub(a_i, b_i);
	*c_q = q_sub(a_q, b_q);
}

/* End of wiki code */

/* It needs some classes, but they are C++, maybe structures? */
void swift(
	Q_BASE val, Q_BASE prev_i, Q_BASE prev_q,
	Q_BASE shift_i, Q_BASE shift_q, Q_BASE *pi, Q_BASE *pq)
{
	Q_BASE i, q;

	q_mul_complex(prev_i, prev_q, shift_i, shift_q, &i, &q);
	i = q_add(i, val);

	*pi = i;
	*pq = q;
}
#endif //#if GOERTZEL_v3



static FLOAT goertzel_sample_rate = DSP_FD_SAMPLING_RATE;
static U32 goertzel_buf_size = DSP_FD_BUF_SIZE;
static U32 goertzel_mashtab = GOERTZEL_MASHTAB;

 S64 re[ DSP_FD_CHANNEL_NUM ];
 S64 im[ DSP_FD_CHANNEL_NUM ];

typedef struct {
    S32 xm1;
    S32 ym1;
} dsp_fd_dc_bloker_t;

dsp_fd_dc_bloker_t dc_bloker[ DSP_FD_CHANNEL_NUM ];
/**
  y = x - xm1 + 0.995 * ym1;
  xm1 = x;
  ym1 = y;
Here, x denotes the current input sample, and y denotes the current output sample.
 The variables xm1 and ym1 hold once-delayed input and output samples, respectively
 (and are typically initialized to zero). In this implementation, the pole is
fixed at $ R=0.995$, which corresponds to an adaptation time-constant of
approximately $ 1/(1-R) = 200$ samples. A smaller $ R$ value allows faster tracking
of ``wandering dc levels'', but at the cost of greater low-frequency attenuation.
 * @brief dsp_fd_dc_bloker
 */
S32 fd_dsp_dc_bloker( dsp_fd_dc_bloker_t *p, S32 ns )
{
#define DSP_FD_DC_BLOCK_COEF	900
#if 1
    S32 x = ns * (( 1000 - DSP_FD_DC_BLOCK_COEF )); //compute new x * 0.05
    x = x * 0xFF; // to fixed point

    S32 y = p->xm1;
    y = y * ( DSP_FD_DC_BLOCK_COEF ); //compute old y * 0.95
    //y = y * 100; //to fixed  point

    y = x + y; //compute sum

    y = y / 1000; //get 100 proc
    p->xm1 = y; //store
    y = y / 0xFF; //from fixed point
//    if( y < 0 )
//        tmp -= 1;

    return ns - y; //compute delta - sub zero level
#else
    ns = ns << 16; //to fixed point
    S32 tmp = DSP_FD_DC_BLOCK_COEF * p->ym1; //old 0.95
    S32 y = ns - p->xm1; //get delta
    y = y + tmp;
    p->xm1 = ns;
    tmp = y >> 16; //from fixed point
    p->ym1 = tmp;
    if( y < 0 )
        return tmp - 1;
    else //if(value >= 0)
        return tmp;
#endif

}

//typedef struct {
//    S32 xm1;
//    S32 ym1;
//} fd_dsp_filter_t;
//
//fd_dsp_filter_t fd_filter[ DSP_FD_CHANNEL_NUM ];
//S32 fd_dsp_filter( fd_dsp_filter_t *p, S32 ns )
//{
//#define DSP_FD_FILT_COEF	980
//    S32 x = ns * (( 1000 - DSP_FD_FILT_COEF ) * 0xFF ); //compute new x * 0.05
//    //x = x * ; // to fixed point
//
//    S32 y = p->xm1;
//    y = y * ( DSP_FD_FILT_COEF ); //compute old y * 0.95
//    //y = y * 100; //to fixed  point
//
//    y = x + y; //compute sum
//
//    y = y / 1000; //get 100 proc
//    p->xm1 = y; //store
//    y = y / 0xFF; //from fixed point
////    if( y < 0 )
////        tmp -= 1;
//
//    return y; //compute delta - sub zero level
//}


void fd_dsp_frq_set( U32 n, FLOAT f )
{
#if DSP_FD_CODE_RAM
	test_param( f >= DSP_FD_SAMPLING_RATE / 2.0f );
    frq[ n ] = f;
#endif
}

FLOAT fd_dsp_frq_get( U32 n )
{
#if DSP_FD_CODE_RAM
    return frq[ n ];
#else
    return 0;
#endif
}

void fd_dsp_sample_rate_set( FLOAT sr )
{
	//test_param( sr < 1.0 );
	//test_param( sr > DSP_FD_SAMPLING_RATE ); //TODO
    goertzel_sample_rate = sr;
}

FLOAT fd_dsp_sample_rate_get( void )
{
    return goertzel_sample_rate;
}

void fd_dsp_buf_size_set( U32 s )
{
	test_param( s > DSP_FD_BUF_SIZE );
	goertzel_buf_size = s;
}

U32 fd_dsp_buf_size_get( void )
{
	return goertzel_buf_size;
}

void fd_dsp_mashtab_set( U32 m )
{
	test_param( m > 31 ); //TODO
	goertzel_mashtab = m;
}

U32 fd_dsp_mashtab_get( void )
{
	return goertzel_mashtab;
}

#if GOERTZEL_v2
static FLOAT s_prev[ DSP_FD_CHANNEL_NUM ];
static FLOAT s_prev2[ DSP_FD_CHANNEL_NUM ];
//static FLOAT totalpower = 0.0;
static int N = 0;
static FLOAT coeff[ DSP_FD_CHANNEL_NUM ];
#endif

#if GOERTZEL_v3
#define I_OFFSET 0
#define Q_OFFSET 1
static Q_BASE s_prev[ 2 * DSP_FD_CHANNEL_NUM ];
static Q_BASE shift_i = 0, shift_q = 0;
#endif

void fd_dsp_init( void )
{
#ifdef HEY
    test_qfixed();
#endif

//	//dc remove filter init
//    for( i = 0; i < DSP_FD_CHANNEL_NUM; i++ )
//	{
//        //dc_bloker[i].xm1 = 0;
//	}
#if GOERTZEL_v1 && DSP_FD_CODE_RAM
	// FFT-Goertzel init =======================================================
	//for( j = 0; j < DSP_FD_FRQ_NUM; j++ )
//	{
//    	FLOAT omega = ( (FLOAT)2.0 * (FLOAT)_PI * (FLOAT)frq[0] ) / (FLOAT)dsp_fd_sample_rate_get();
//	    for( U32 i = 0; i < goertzel_buf_size; i++ )
//	    {
//            gsin_buf[i] = sinf( (FLOAT)i * omega ) * (FLOAT)2047.0f;
//            gcos_buf[i] = cosf( (FLOAT)i * omega ) * (FLOAT)2047.0f;
//	    }
//	}
	for( U32 j = 0; j < DSP_FD_FRQ_NUM; j++ )
	{
        DOUBLE omega = ( 2.0 * _PI * (DOUBLE)frq[j] ) / fd_dsp_sample_rate_get();
	    for( U32 i = 0; i < goertzel_buf_size; i++ )
	    {
            gsin_buf[j][i] = sin( (DOUBLE)i * omega ) * (DOUBLE)0x7FF;
            gcos_buf[j][i] = cos( (DOUBLE)i * omega ) * (DOUBLE)0x7FF;
	    }
	}
#endif
#if GOERTZEL_v2
	// Sliding FFT-Goertzel init ===============================================
	//for( j = 0; j < DSP_FD_FRQ_NUM; j++ )
	{
		for( U32 i = 0; i < DSP_FD_CHANNEL_NUM; i++ )
		{
			s_prev[i] = 0.0;
			s_prev2[i] = 0.0;
			//totalpower = 0.0;
			//N = 0;
			coeff[i] = 2 * cos( 2 * _PI * frq[0] / dsp_fd_sample_rate_get() );

			fd_filter[i].xm1 = 0;
			fd_filter[i].ym1 = 0;
		}
	}
#endif
#if GOERTZEL_v3
	FLOAT scale = exp(-1./TAU) * QQ;

	shift_i = satQ(cos(2. * M_PI * FREQ) * scale);
	shift_q = satQ(sin(2. * M_PI * FREQ) * scale);
#endif
}

//#define SNR_DELAY	25//70 //25
//filter_window_32b_t filt_snr[4] = { {.tmp = 0, .window = SNR_DELAY },{.tmp = 0, .window = SNR_DELAY },{.tmp = 0, .window = SNR_DELAY },{.tmp = 0, .window = SNR_DELAY } };
static S32 ref_val[8];

#pragma GCC push_options
//#pragma GCC optimize ("03") // ("-Ofast")
void fd_dsp_process_v1( U16 *p, fd_data_t *fdp )
{
#if GOERTZEL_v1
    UINT i, n;
    S32 tmpS32;
//	U32 rssi;
    S32 tmpV;
    S64 mag;
    U16 *pp;

	pp = p; //init pointer

	// looking for the ref value for each channel
	for( i = 0; i < DSP_FD_CHANNEL_NUM; i++ )
	{
		ref_val[i] = 0;
	}
	for( n = 0; n < goertzel_buf_size; n++ )
	{
		for( i = 0; i < DSP_FD_CHANNEL_NUM; i++ )
		{
			tmpS32 = (S32)*pp++; //get value
			ref_val[i] += tmpS32;
		}
	}
	for( i = 0; i < DSP_FD_CHANNEL_NUM; i++ )
	{
		ref_val[i] = ref_val[i] / goertzel_buf_size;
	}

	// compute reduced FFT or Goertzel
    for( INT j = 0; j < 1; j++ )//DSP_FD_FRQ_NUM
    {
		for( i = 0; i < DSP_FD_CHANNEL_NUM; i++ ) //set to zero
		{
			re[i] = 0;
			im[i] = 0;
		}

        pp = p; //reinit pointer

        for( n = 0; n < DSP_FD_BUF_SIZE; n++ )
		{
			for( i = 0; i < DSP_FD_CHANNEL_NUM; i++ )
			{
                tmpS32 = (S32)*pp++; //get value

				/* remove ref_val */
                //tmpS32 = dsp_fd_dc_bloker( &dc_bloker[i], tmpS32 );
                tmpS32 = tmpS32 - ref_val[i]; //2048;

				/* compute real and image values */
                tmpV = (S32)gsin_buf[j][n] * tmpS32;
                re[i] = re[i] + tmpV;
                tmpV = (S32)gcos_buf[j][n] * tmpS32;
                im[i] = im[i] + tmpV;
			}
		}

        // compute magnitude of signals
		for( i = 0; i < DSP_FD_CHANNEL_NUM; i++ )
		{
            re[i] = re[i] / 1000;
            im[i] = im[i] / 1000;
			re[i] = ( re[i] * re[i] ); //^2
			im[i] = ( im[i] * im[i] ); //^2
			mag = sqrtf( re[i] + im[i] ); //sum

            if( mag > 0x7FFFFFFF ) // todo test for overflow
			{
                mag = 0x7FFFFFFF;
			}

			mag = ( mag );//>> 6;// >> goertzel_mashtab; // divider

			fdp->v[ j * DSP_FD_CHANNEL_NUM + i ] = mag; //save

        }

//		// compute stretch of signal
//		for( n = 0; n < DSP_FD_CHANNEL_NUM / 4; n++ )
//		{
//	        rssi = 0;
//			for( i = 0; i < 4; i++ )
//			{
//				rssi += fdp->v[ j * DSP_FD_CHANNEL_NUM + n * 4 + i ];
//	        }
//
//			fdp->rssi[ j * DSP_FD_CHANNEL_NUM / 4 + n ] = rssi; //save rssi
//        }

//		tmpV = 0;
//		for( i = 0; i < DSP_FD_CHANNEL_NUM; i++ )
//		{
//			tmpS32 = (fdp->v_old[i] - fdp->v[i] );
//			tmpS32 = tmpS32 > 0 ? tmpS32 : tmpS32 * -1; //aqbs
//			tmpV += tmpS32;
//			fdp->v_old[i] = fdp->v[i]; //store for future use
//		}

		//fdp->snr[j] = filter_window_S32( &filt_snr[0],  (rssi) / ( tmpV ));
	}

#if( 8 == DSP_FD_CHANNEL_NUM )
    U32 rssi;
	// compute stretch of signal after 1-x cascade for 1frq
	rssi = fdp->v[0]  + fdp->v[1]  + fdp->v[2]  + fdp->v[3]; // signal level for 1 frq
	fdp->rssi[0] = _constrain( rssi, 1, 0xFFFF );

	// compute stretch of signal after 2-x cascade for 1frq
	rssi = fdp->v[4]  + fdp->v[5]  + fdp->v[6]  + fdp->v[7];
	fdp->rssi[1] = _constrain( rssi, 1, 0xFFFF );

	// compute stretch of signal after 1-x cascade for 2frq
	rssi = fdp->v[8]  + fdp->v[9]  + fdp->v[10] + fdp->v[11];
	fdp->rssi[2] = _constrain( rssi, 1, 0xFFFF );

	// compute stretch of signal after 2-x cascade for 2frq
	rssi = fdp->v[12] + fdp->v[13] + fdp->v[14] + fdp->v[15];
	fdp->rssi[3] = _constrain( rssi, 1, 0xFFFF );

	// compute signal to noise ratio
	S32 rssiA, rssiB;

	// signal level after 1-x cascade
	rssiA = fdp->rssi[0];
	rssiB = _constrain( fdp->rssi[2] >> 10, 1, 0xFFFF );
	fdp->snr[0] = rssiA / rssiB;

	// signal level after 2-x cascade
	rssiA = fdp->rssi[1];
	rssiB = _constrain( fdp->rssi[3] >> 10, 1, 0xFFFF );
	fdp->snr[1] = rssiA / rssiB;



	// signal level after 2-x cascade for 1ch
	rssiA = fdp->v[0];
	rssiB = _constrain( fdp->v[0] >> 10, 1, 0xFFFF );
	fdp->snr[2] = rssiB;

	// signal level after 2-x cascade for 2ch
	rssiA = fdp->v[1];
	rssiB = _constrain( fdp->v[1] >> 10, 1, 0xFFFF );
	fdp->snr[3] = rssiB;

	// signal level after 2-x cascade for 3ch
	rssiA = fdp->v[2];
	rssiB = _constrain( fdp->v[2] >> 10, 1, 0xFFFF );
	fdp->snr[4] = rssiB;

	// signal level after 2-x cascade for 4ch
	rssiA = fdp->v[3];
	rssiB = _constrain( fdp->v[3] >> 10, 1, 0xFFFF );
	fdp->snr[5] = rssiB;
#else

//	// compute stretch of signal after 1-x cascade for 1frq
//	rssi = fdp->v[0]  + fdp->v[1]  + fdp->v[2]  + fdp->v[3]; // signal level for 1 frq
//	fdp->rssi[0] = _constrain( rssi, 1, 0xFFFF );

//	rssi = fdp->v[4]  + fdp->v[5]  + fdp->v[6]  + fdp->v[7];
//	fdp->rssi[1] = _constrain( rssi, 1, 0xFFFF );

//	rssi = fdp->v[8]  + fdp->v[9]  + fdp->v[10] + fdp->v[11];
//	fdp->rssi[2] = _constrain( rssi, 1, 0xFFFF );

//	rssi = fdp->v[12] + fdp->v[13] + fdp->v[14] + fdp->v[15];
//	fdp->rssi[3] = _constrain( rssi, 1, 0xFFFF );

//	rssi = fdp->v[8]  + fdp->v[9]  + fdp->v[10] + fdp->v[11];
//	fdp->rssi[4] = _constrain( rssi, 1, 0xFFFF );

//	rssi = fdp->v[12] + fdp->v[13] + fdp->v[14] + fdp->v[15];
//	fdp->rssi[5] = _constrain( rssi, 1, 0xFFFF );

//	// compute signal to noise ratio
//	S32 rssiA, rssiB;

//	// signal level after 1-x cascade
//	rssiA = fdp->rssi[0];
//	rssiB = _constrain( fdp->rssi[2] >> 10, 1, 0xFFFF );
//	fdp->snr[0] = rssiA / rssiB;

//	// signal level after 2-x cascade
//	rssiA = fdp->rssi[1];
//	rssiB = _constrain( fdp->rssi[3] >> 10, 1, 0xFFFF );
//	fdp->snr[1] = rssiA / rssiB;


//	// signal level after 2-x cascade for 1ch
//	rssiA = fdp->v[0];
//	rssiB = _constrain( fdp->v[8] >> 10, 1, 0xFFFF );
//	fdp->snr[2] = rssiA / rssiB;

//	// signal level after 2-x cascade for 2ch
//	rssiA = fdp->v[1];
//	rssiB = _constrain( fdp->v[9] >> 10, 1, 0xFFFF );
//	fdp->snr[3] = rssiA / rssiB;

//	// signal level after 2-x cascade for 3ch
//	rssiA = fdp->v[2];
//	rssiB = _constrain( fdp->v[10] >> 10, 1, 0xFFFF );
//	fdp->snr[4] = rssiA / rssiB;

//	// signal level after 2-x cascade for 4ch
//	rssiA = fdp->v[3];
//	rssiB = _constrain( fdp->v[11] >> 10, 1, 0xFFFF );
//	fdp->snr[5] = rssiA / rssiB;
#endif


#endif //GOERTZEL_v1

#if GOERTZEL_v2
    FLOAT s, power;

    //for( j = 0; j < DSP_FD_FRQ_NUM; j++ )
    {
    	N = 0;
    	rssi = 0;
        for( n = 0; n < goertzel_buf_size; n++ )
		{
			for( i = 0; i < DSP_FD_CHANNEL_NUM; i++ )
			{
                tmpS32 = (S32)*p++; //get value

				// remove dc level
                tmpS32 = tmpS32 - 2048;//
                //tmpS32 = dsp_fd_dc_bloker( &dc_bloker[i], tmpS32 );

                s = tmpS32 + coeff[i] * s_prev[i] - s_prev2[i];
                s_prev2[i] = s_prev[i];
                s_prev[i] = s;

                N++;
    			power = s_prev2[i] * s_prev2[i] + s_prev[i] * s_prev[i]
					- coeff[i] * s_prev[i] * s_prev2[i];

    			//totalpower += tmpS32 * tmpS32;
    			//if (totalpower == 0) totalpower = 1;
    			fdp->v[i] = 2 + ( power ) / ( 1 << goertzel_mashtab );// / totalpower;// / N;

    			//level[j][i] = dsp_fd_filter( &fd_filter[i], level[j][i] );

			}
		}
        fdp->rssi = rssi;
	}
#endif //GOERTZEL_v2
}

#if GOERTZEL_v3
void fd_dsp_process_v3( U16 *p, fd_data_t *fdp )
{
    UINT i, n;
 	U32 rssi = 0;

 	for (n = 0; n < goertzel_buf_size; n++ ) {
 		for (i = 0; i < DSP_FD_CHANNEL_NUM; i++ ) {
 			S32 val = (*p++);
 			val -= 2048;
 			val <<= Q;
 			swift(val,
 				  s_prev[i * 2 + I_OFFSET],
 				  s_prev[i * 2 + Q_OFFSET],
 				  shift_i, shift_q,
 				  &s_prev[i * 2 + I_OFFSET],
 				  &s_prev[i * 2 + Q_OFFSET]);
 		}
 	}

 	for (i = 0; i < DSP_FD_CHANNEL_NUM; i++) {
 		FLOAT ii = (FLOAT)s_prev[i * 2 + I_OFFSET] / QQ,
 			   q = (FLOAT)s_prev[i * 2 + Q_OFFSET] / QQ;

 		fdp->v[i] = sqrt(ii*ii + q*q);
 		rssi += fdp->v[i];

 	}
 	fdp->rssi[0] = rssi;
}
#endif

void fd_dsp_vector_get( fd_data_t *fd, FLOAT amp )
{
	FLOAT q1, q2, q3, q4, q5, q6, qsum, x, y;
	UINT i;

	test_param( fd == NULL );
	test_param( amp > 10000 );
	//test_param( fd->fd_num == 0 );
	//test_param( fd->fd_num > 4 );
	//test_param( vp == NULL );

	x = 0;
	y = 0;
    //for( U32j = 0; j < DSP_FD_FRQ_NUM; j++ )
	{
    	switch( fd->fd_num )
    	{
    	case 1:
    		//get values
    		q1 = fd->v[0];
    		qsum = q1;
            x = 0;
            y = 0;
    		break;

    	case 2:
    		//get values
    		q1 = fd->v[0];
    		q2 = fd->v[1];

    		//compute 1d vector
    		qsum = q1 + q2;
    		qsum = ( qsum == 0 ) ? 1 : qsum; //for division to zero!
    		x = ( ( q1 - q2 ) * amp ) / qsum;
    		break;

    	case 3:
//    		switch( fd->vector_mode )
//    		{
//    		case 0:
//        		//get values
//        		q1 = fd->v[0];
//        		q2 = fd->v[1];
//        		q3 = fd->v[2];
//
//        		//compute 2d vector
//        		fx = ( ( q1 - q2 ) / ( q1 + q2 ) ) * amp;
//        		fy = ( ( ( q1 + q2 ) / 2 - q3 ) / ( ( q1 + q2 ) / 2 + q3 ) ) * amp;
//        		break;
//
//    		case 1:
				//get values
				q1 = fd->v[0];
				q2 = fd->v[1];
				q3 = fd->v[2];

#define M_SQRT_3_OVER_2 0.8660254037844387f
				//compute 2d vector
				x = (q1 - (q2 + q3) / 2);
				y = M_SQRT_3_OVER_2 * (q2 - q3);
//				break;
//
//    		case 2: {
//				UINT max = 0;
//				static const FLOAT v[3][2] = {
//						{ 1.0, 0.0 },
//						{-0.4999999999999998, 0.8660254037844387},
//						{-0.5000000000000004, -0.8660254037844385}
//				};
//
//				for (i = 0; i < 3; i++)
//					max = (max > fd->v[i]) ? max : fd->v[i];
//
//				//get values
//				for (i = 0; i < 3; i++) {
//					fx += v[i][0] * fd->v[i] / max;
//					fy += v[i][1] * fd->v[i] / max;
//				}
//    		} break;
//    		default: break;
//    		}
    	break;

		case 4:
		case 8:
            for( i = 0; i < fd->fd_num; i += 4 )
			{
				//get values
				q1 = fd->v[i+0];
				q2 = fd->v[i+1];
				q3 = fd->v[i+2];
				q4 = fd->v[i+3];

                qsum = q1 + q2 + q3 + q4;// old

                //qsum = sqrtf( q1*q1 + q2*q2 + q3*q3 + q4*q4 );

				qsum = ( qsum < 1 ) ? 1 : qsum; //for division to zero!

				//compute 2d vector
				x = ((( q1 + q4 ) - ( q2 + q3 ))) / qsum;
				y = ((( q1 + q2 ) - ( q4 + q3 ))) / qsum;

				x = x * amp;
				y = y * amp;

				// correction
				if( x > amp )
					x = amp;
                if( x < ( amp * -1 ))
                    x = ( amp * -1 );
				if( y > amp )
					y = amp;
                if( y < ( amp * -1 ))
                    y = ( amp * -1 );

				//store points for all level
                fd->x[i/4] = x;//_constrain( fx, -(AREA_SIZE), AREA_SIZE );
                fd->y[i/4] = y;//_constrain( fy, -(AREA_SIZE), AREA_SIZE );

			}
			break;

		case 12:
			for( i = 0; i < 12; i += 6 )
			{
				//get values
				q1 = fd->v[i+0];
				q2 = fd->v[i+1];
				q3 = fd->v[i+2];
				q4 = fd->v[i+3];
				q5 = fd->v[i+4];
				q6 = fd->v[i+5];

				qsum = q1 + q2 + q3 + q4 + q5 + q6;//qsum = fd->rssi; //22+44+66+44=176
				qsum = ( qsum < 1 ) ? 1 : qsum; //for division to zero!
				//todo divide to max or sum?
				//compute 2d vector
				x = ((( q1 + q4 ) - ( q2 + q3 ))) / qsum;
				y = ((( q1 + q2 ) - ( q4 + q3 ))) / qsum;

				x = x * amp;
				y = y * amp;

//				// correction
//				if( x > amp )
//					x = amp;
//				if( x < ( amp * -1 ) )
//					x = ( amp * -1 ) ;
//				if( y > amp )
//					y = amp;
//				if( y < ( amp * -1 ) )
//					y = ( amp * -1 ) ;

				//store points for all level
				fd->x[i/6] = x;
				fd->y[i/6] = y;
			}
			break;

		default: break;
		}
	}
}

#include "_misc.h"

#pragma GCC pop_options

//static FLOAT calibrate_angle[ FD_CALIBRATE_DOTS ];
extern FLOAT angle;

void fd_dsp_calibrate_vector_get( fd_data_t *pfd_data, FLOAT *clb_val )
{
    vector_2D_FLOAT_t vxy;
    test_param( pfd_data == NULL );
    test_param( clb_val == NULL );

    for( INT i = 0; i < 2; i++ ) //for branches
    {
    	// get values
        vxy.x = pfd_data->x[i];
        vxy.y = pfd_data->y[i];

        pfd_data->len[i] = vect_len_FLOAT( &vxy ); //sqrtf( vxy.x * vxy.x + vxy.y * vxy.y );//

        if( 0 == vxy.x )
        	vxy.x = vxy.x + 0.000001f;
        if( 0 == vxy.y )
        	vxy.y = vxy.y + 0.000001f;

        pfd_data->dir[i] = atan2f( vxy.y, vxy.x ) * RAD2DEG;

        //correction, from -/+180 to 0 - 360
        S32 bufpos = (S32)pfd_data->dir[i] + FD_CLB_DOTS/2;
        //test_param( bufpos >= FD_CALIBRATE_DOTS );
//        if( bufpos > (FD_CALIBRATE_DOTS)) //!
//        {
//            bufpos = FD_CALIBRATE_DOTS;
//        }
//        if( bufpos < 0 )
//        {
//            bufpos = 0;
//        }
        //test_param( bufpos < 0 );

        pfd_data->bufpos[i] = bufpos;

        //    result.x = p1.x + t * (p2.x - p1.x);
        //    result.y = p1.y + t * (p2.y - p1.y);
            //fd->dir[1] = bufpos;//dir;
        FLOAT clb_len = pfd_data->len[i] * clb_val[ i * FD_CLB_DOTS + bufpos ];

        pfd_data->fx[i] = _vect_x_FLOAT( clb_len, pfd_data->dir[i] );
        pfd_data->fy[i] = _vect_y_FLOAT( clb_len, pfd_data->dir[i] );
    }
}



#if FD_DRAW
#include "colors.h"
#include "halPaint.h"
#include "modPaint.h"
//#include "_filter.h"
#include "xprintf.h"


void fd_dsp_paint_vector( COORD center_x, COORD center_y, COORD x, COORD y, COORD mark_size )
{
#if( 1 == FD_DSP_CROSS_TYPE )//xcross + dot
	paint_line_x( center_x + x - mark_size, center_y + y, mark_size/2 );
	paint_line_x( center_x + x + mark_size/2, center_y + y, mark_size/2 );
	paint_line_y( center_x + x, center_y + y - mark_size, mark_size/2 );
	paint_line_y( center_x + x, center_y + y + mark_size/2, mark_size/2 );
	paint_pixel( center_x + x, center_y + y );
#endif
#if ( 2 == FD_DSP_CROSS_TYPE )//BOARD_0_miniF401 //xcross thick
	paint_line_x( center_x + x - mark_size, center_y + y-1, mark_size/2 );
	paint_line_x( center_x + x - mark_size, center_y + y, mark_size/2 );
	paint_line_x( center_x + x - mark_size, center_y + y+1, mark_size/2 );

	paint_line_x( center_x + x + mark_size/2, center_y + y-1, mark_size/2 );
	paint_line_x( center_x + x + mark_size/2, center_y + y, mark_size/2 );
	paint_line_x( center_x + x + mark_size/2, center_y + y+1, mark_size/2 );

	paint_line_y( center_x + x-1, center_y + y - mark_size, mark_size/2 );
	paint_line_y( center_x + x, center_y + y - mark_size, mark_size/2 );
	paint_line_y( center_x + x+1, center_y + y - mark_size, mark_size/2 );

	paint_line_y( center_x + x-1, center_y + y + mark_size/2, mark_size/2 );
	paint_line_y( center_x + x, center_y + y + mark_size/2, mark_size/2 );
	paint_line_y( center_x + x+1, center_y + y + mark_size/2, mark_size/2 );
#endif
#if ( 3 == FD_DSP_CROSS_TYPE ) //simple cross
	paint_line_x( center_x + x - (mark_size>>1), center_y + y, mark_size );
	paint_line_y( center_x + x, center_y + y - (mark_size>>1), mark_size );
#endif
}

static CHAR str[64];
void fd_dsp_paint_digit( COORD x, COORD y, U32 val )
{
	COORD xn = x;

//	if( val < 1000000000 )
//		xsprintf( str, "  " );
//	else
//		xsprintf( str, "%2u", val / 1000000000 );
//	xn = paint_text_xy( x, y, str );
//	val = val % 1000000000;
	if( val < 1000000 )
		xsprintf( str, "   " );
	else
		xsprintf( str, "%3u", val / 1000000 );
	xn = paint_text_xy( xn + 2, y, str );
	val = val % 1000000;
	if( val < 1000 )
		xsprintf( str, "   " );
	else
		xsprintf( str, "%3u", ( val % 1000000 ) / 1000 );
	xn = paint_text_xy( xn + 2, y, str );
	//val = val % 1000;
	if( val > 1000 )
		xsprintf( str, "%03u", val % 1000 );
	else
		xsprintf( str, "%3u", val % 1000 );
	paint_text_xy( xn + 2, y, str );
}

extern U16 calibration;
extern U16 set_PID_on;

COORD line_train_x[2][256];
COORD line_train_y[2][256];
static COLOR colors[ DSP_FD_CHANNEL_NUM ] = {};

COLOR fd_dsp_paint_color( U8 num )
{
	return colors[ num ];
}

void fd_dsp_draw( fd_data_t *pfd_data, U8 mode, U32 mul )
{
	static BOOL color_generation = FALSE;
	static COORD center_x;
	static COORD center_y;

	static fd_data_t prev_fd_data;
	static U32 tmpfA0 = 0;
    static U32 tmpfA1 = 0;
	static U32 tmpfA2 = 0;
	static U32 tmpfA3 = 0;
	static U32 tmpfA4 = 0;
	static U32 tmpfA5 = 0;
	static U32 radius;

	//static filter_window_FLOAT_t fwf0;
	//static filter_window_FLOAT_t fwf1;
	static U8 delay_cnt = 0;
	COORD xn;


    if( color_generation == FALSE )
    {
        U32 hue;
        color_generation = TRUE;
        for( INT i = 0; i < DSP_FD_CHANNEL_NUM; i++ )
        {
            hue = ((100 * i) / 4 );
            colors[i] = HSV_to_RGB( hue, 255, 255 );
        }
//
//    	fwf0.window = 90.0;
//    	fwf1.window = 90.0;

    	center_x = hal_paint_screen_width()/2;
    	center_y = hal_paint_screen_height()/2 + 11;

        for( INT i = 0; i < 128; i++ )
		{
            line_train_x[0][i] = center_x;
            line_train_y[0][i] = center_y;
            line_train_x[1][i] = center_x;
            line_train_y[1][i] = center_y;
		}
    }

    fd_dsp_vector_get( pfd_data, GRID_SIZE*GRID_N * mul );

	// clear old point
	paint_color( COLOR_BLACK );

    for( INT i = 0; i < FD_DSP_TRAIN_DOTS; i++ )
	{
        paint_line( line_train_x[1][i], line_train_y[1][i], line_train_x[1][i+1], line_train_y[1][i+1] );
	}

	for( INT i = 0; i < 2; i++ )
	{
		fd_dsp_paint_vector( center_x, center_y, prev_fd_data.x[i], prev_fd_data.y[i], MARK_SIZE );
	}
//	dsp_fd_paint_vector( center_x, center_y,
//			prev_fd_vector.x[1], prev_fd_vector.y[1], mark_size );

#if BOARD_712_Lift
	paint_circle( center_x, center_y, radius, PAINT_QUARTERS_ALL, 0 );
#endif

	// copy new coordinates ----------------------------------------------------
	prev_fd_data.x[0] = _constrain( pfd_data->x[0], -(AREA_SIZE), AREA_SIZE );
	prev_fd_data.y[0] = _constrain( pfd_data->y[0], -(AREA_SIZE), AREA_SIZE );
	prev_fd_data.x[1] = _constrain( pfd_data->x[1], -(AREA_SIZE), AREA_SIZE );
	prev_fd_data.y[1] = _constrain( pfd_data->y[1], -(AREA_SIZE), AREA_SIZE );

	// draw x-cross ------------------------------------------------------------
	paint_color( COLOR_BLUE );
	paint_line( center_x, center_y - AREA_SIZE, center_x, center_y + AREA_SIZE );
	paint_line( center_x - AREA_SIZE, center_y, center_x + AREA_SIZE, center_y );

	// draw coord grid ---------------------------------------------------------
	paint_color( COLOR_BLUE + COLOR_GREEN );
	for( COORD j = -(AREA_SIZE); j <= AREA_SIZE; j += GRID_SIZE )
	{
		for( COORD i = -(AREA_SIZE); i <= AREA_SIZE; i += GRID_SIZE )
		{
			paint_pixel( center_x + j, center_y + i );
		}
	}


	//move points from worm
	for( INT i = 128 -1; i > 0; i-- )
	{
        line_train_x[1][i] = line_train_x[1][i-1];
        line_train_y[1][i] = line_train_y[1][i-1];
	}
    line_train_x[1][0] = prev_fd_data.x[1] + center_x;
    line_train_y[1][0] = prev_fd_data.y[1] + center_y;
    line_train_x[1][0] = _constrain( line_train_x[1][0], 0, hal_paint_screen_width()-1 );
    line_train_y[1][0] = _constrain( line_train_y[1][0], 0, hal_paint_screen_height()-1 );

	paint_color( COLOR_LIME );
    for( INT i = 0; i < FD_DSP_TRAIN_DOTS; i++ )
	{
        paint_line( line_train_x[1][i], line_train_y[1][i], line_train_x[1][i+1], line_train_y[1][i+1] );
	}

	paint_color( COLOR_LIME );
	fd_dsp_paint_vector( center_x, center_y, prev_fd_data.x[1], prev_fd_data.y[1], MARK_SIZE );

	if( mode )
	{
		paint_color( COLOR_ORANGE );
		fd_dsp_paint_vector( center_x, center_y, prev_fd_data.x[0], prev_fd_data.y[0], MARK_SIZE );
	}


	U32 tmpf0 = _constrain( pfd_data->snr[0], 0, 0xFFFF );
	U32 tmpf1 = _constrain( pfd_data->snr[1], 0, 0xFFFF );//filter_window_FLOAT( &fwf1, pfd_data->snr );

	U32 tmpf2 = _constrain( pfd_data->snr[2], 0, 0xFFFF );
	U32 tmpf3 = _constrain( pfd_data->snr[3], 0, 0xFFFF );
	U32 tmpf4 = _constrain( pfd_data->snr[4], 0, 0xFFFF );
	U32 tmpf5 = _constrain( pfd_data->snr[5], 0, 0xFFFF );

#if BOARD_0_miniF401
	if( ++delay_cnt > 5 )
#else
	if( ++delay_cnt > 1 )
#endif
	{
		delay_cnt = 0;

		tmpfA0 = tmpf0;
		tmpfA1 = tmpf1;
		tmpfA2 = tmpf2;
		tmpfA3 = tmpf3;
		tmpfA4 = tmpf4;
		tmpfA5 = tmpf5;

		for( INT i = 0; i < 4; i++ ) //DSP_FD_CHANNEL_NUM
		{
			if( mode )
			{
				paint_color( fd_dsp_paint_color( i ));
			}
			else
				paint_color( COLOR_BLACK );
#if BOARD_712_Lift

			xsprintf( str, "ch %2u ", i + 9 );
			xn = paint_text_xy( 8, 2 + 12 * i, str );
			fd_dsp_paint_digit( xn, 2 + 12 * i, pfd_data->v[i] );

#else
			xsprintf( str, "ch %u           ", i + 1 );
			xn = paint_text_xy( 45, 2 + 12 * i, str ); //xn = paint_text_xy( 2, 2 + 23 * i, str );
			fd_dsp_paint_digit( xn, 2 + 12 * i, pfd_data->v[i] ); //fd_dsp_paint_digit( xn, 2 + 23 * i, pfd_data->v[i] );
#endif
		}


		for( INT i = 4; i < 8; i++ ) //DSP_FD_CHANNEL_NUM
		{
			paint_color( fd_dsp_paint_color( i ) );
#if BOARD_712_Lift

			xsprintf( str, "ch %u ", i + 9 );
			xn = paint_text_xy( 8, 2 + 12 * i, str );
			fd_dsp_paint_digit( xn, 2 + 12 * i, pfd_data->v[i] );

#else
			xsprintf( str, "ch %u           ", i + 1 );
			xn = paint_text_xy( 45, 2 + 12 * i, str ); //xn = paint_text_xy( 2, 2 + 23 * i, str );
			fd_dsp_paint_digit( xn, 2 + 12 * i, pfd_data->v[i] ); //fd_dsp_paint_digit( xn, 2 + 23 * i, pfd_data->v[i] );
#endif
		}
	}

#if BOARD_712_Lift
	paint_color( COLOR_ORANGE );
	xsprintf( str, "snr1" );
	xn = paint_text_xy( 8, hal_paint_screen_height()-100, str );
	fd_dsp_paint_digit( xn, hal_paint_screen_height()-100, tmpfA0 );

	paint_color( COLOR_LIME );
	xsprintf( str, "snr2" );//xsprintf( str, "snr2   %6u", tmpfA1 );
	xn = paint_text_xy( 8, hal_paint_screen_height()-80, str );
	fd_dsp_paint_digit( xn, hal_paint_screen_height()-80, tmpfA1 );

	paint_color( COLOR_RED );
	xsprintf( str, "mul" );
	xn = paint_text_xy( 8, hal_paint_screen_height()-60, str );
	fd_dsp_paint_digit( xn, hal_paint_screen_height()-60, mul );
#else
	paint_color( COLOR_LIME );
	xsprintf( str, "snr after 1-x all    " );
	xn = paint_text_xy( 25, hal_paint_screen_height()-60, str );
	fd_dsp_paint_digit( xn, hal_paint_screen_height()-60, tmpfA0 );

	paint_color( COLOR_ORANGE );
	xsprintf( str, "snr after 2-x all    " );//xsprintf( str, "snr2   %6u", tmpfA1 );
	xn = paint_text_xy( 25, hal_paint_screen_height()-50, str );
	fd_dsp_paint_digit( xn, hal_paint_screen_height()-50, tmpfA1 );
#endif


	//get radius
	FLOAT radiusf = 0;
    for( INT i = 0; i < FD_DSP_TRAIN_DOTS; i++ ) //
	{
		FLOAT x, y;
        x = (FLOAT)line_train_x[1][i] - center_x;
		x = x * x;
        y = (FLOAT)line_train_y[1][i] - center_y;
		y = y * y;
		radiusf += sqrtf( x + y );
	}

    radiusf = radiusf / FD_DSP_TRAIN_DOTS;
	radius = radiusf;

#if BOARD_712_Lift
	paint_color( COLOR_GREEN );
	paint_circle( center_x, center_y, radius, PAINT_QUARTERS_ALL, 0 );
#endif

	paint_color( COLOR_LIME );
	xsprintf( str, "Radius  " );
	xn = paint_text_xy( 8, hal_paint_screen_height()-40, str );
	fd_dsp_paint_digit( xn, hal_paint_screen_height()-40, radius );

	// roudness computing
	FLOAT roudnessf = 0;
    for( INT i = 0; i < FD_DSP_TRAIN_DOTS; i++ )
	{
		FLOAT x, y;
        x = (FLOAT)line_train_x[1][i] - center_x;
		x = x * x;
        y = (FLOAT)line_train_y[1][i] - center_y;
		y = y * y;
		roudnessf += fabs( sqrtf( x + y ) - radiusf );
	}

	U32 roudness = roudnessf;

	paint_color( COLOR_SKY_BLUE );
	xsprintf( str, "Roudness  " );
	xn = paint_text_xy( 16, hal_paint_screen_height() - 15, str );
	fd_dsp_paint_digit( xn, hal_paint_screen_height() - 15, roudness );


	//---------- PD_DIRECTION_CALCULATION ----------

//	Y_YP = - math.sin(toRad(zxy_euler:y()));

//	X_YP = math.sin(toRad(zxy_euler:z() + 90));

//	FLOAT BearYP =  wrap360(toDeg(math.atan(X_YP , Y_YP))); //-- calculating this to know which way is up

	//--gcs:send_named_float('BearYP', BearYP + 0.0 );

//	PD_9 = rc:get_pwm(13); //-- former 9
//	PD_10 = rc:get_pwm(14); //-- former 10
//	PD_11 = rc:get_pwm(11);
//	PD_12 = rc:get_pwm(12);

	FLOAT PD_9  = pfd_data->v[0];
	FLOAT PD_10 = pfd_data->v[1];
	FLOAT PD_11 = pfd_data->v[2];
	FLOAT PD_12 = pfd_data->v[3];

	FLOAT PD_SUM = PD_9 + PD_10 + PD_11 + PD_12;

//	if( PD_SUM == 0 )//nil or tostring(PD_SUM) == "nan" )
//	{
//			PD_SUM = 0;
//	}

//	gcs:send_named_float('PD_SUM', PD_SUM + 0.0 );

	FLOAT X_PD, Y_PD;
	if( PD_SUM > 0.0 ) //~= 0 )
	{
		X_PD = ((PD_9 + PD_10) - (PD_12 + PD_11)) / PD_SUM;
		Y_PD = ((PD_9 + PD_12) - (PD_10 + PD_11)) / PD_SUM;
	}
	else
	{
		X_PD =  0.01;
		Y_PD = -0.01;
		//--gcs:send_text(0, "PD default values used")
	}

//	--gcs:send_named_float('X_PD', X_PD + 0.0 )

//	--gcs:send_named_float('Y_PD', Y_PD + 0.0 )

	// FLOAT YPsin = math.sin(toRad(BearYP));

	// FLOAT YPcos = math.cos(toRad(BearYP));

	// FLOAT Y_UD = - YPcos * Y_PD - YPsin * X_PD; //-- "+" means up "-" means down

//	--gcs:send_named_float('Y_UD', Y_UD + 0.0 )

	// FLOAT X_LR = - YPsin * Y_PD - YPcos * X_PD; //-- "+" means left "-" means right

//	--gcs:send_named_float('X_LR', X_LR + 0.0 )

//	FLOAT PD_AV_Y = Y_PD * 0.2; //PD_AV_Y * 0.80 + Y_PD * 0.2;
//
//	FLOAT PD_AV_X = X_PD * 0.2; //PD_AV_X * 0.80 + X_PD * 0.2;


//	FLOAT Y_PD_A = _abs(PD_AV_Y);
//
//	FLOAT X_PD_A = _abs(PD_AV_X);

	FLOAT Y_PD_NA = _abs(Y_PD);

	FLOAT X_PD_NA = _abs(X_PD);


	FLOAT PD_X_SM = (20.602 * Y_PD_NA * Y_PD_NA * Y_PD_NA - 11.12 * Y_PD_NA * Y_PD_NA + 7.4 * Y_PD_NA) * _sign(Y_PD);

//	FLOAT PD_X = (20.602 * Y_PD_A * Y_PD_A * Y_PD_A - 11.12 * Y_PD_A * Y_PD_A + 7.4 * Y_PD_A) * _sign(PD_AV_Y);

//	gcs:send_named_float('PD_X', PD_X + 0.0 )
//	--gcs:send_named_float('PD_Xsm', PD_X_SM + 0.0 )

	FLOAT PD_Y_SM = (20.602 * X_PD_NA * X_PD_NA * X_PD_NA - 11.12 * X_PD_NA * X_PD_NA + 7.4 * X_PD_NA) * _sign(X_PD);

//	FLOAT PD_Y = (20.602 * X_PD_A * X_PD_A * X_PD_A - 11.12 * X_PD_A * X_PD_A + 7.4 * X_PD_A) * _sign(PD_AV_X);

//	gcs:send_named_float('PD_Y', PD_Y + 0.0 )
//	--gcs:send_named_float('PD_Ysm', PD_Y_SM + 0.0 )

	//---------- END_OF_PD_DIRECTION_CALCULATION ----------
#if BOARD_712_Lift
	paint_color( COLOR_SKY_BLUE );
	xsprintf( str, "X_PD     %2.3f", X_PD );
	paint_text_xy( 350, 30, str );
	xsprintf( str, "PD_X_SM     %2.3f", PD_X_SM );
	paint_text_xy( 350, 50, str );

	paint_color( COLOR_ORANGE );
	xsprintf( str, "Y_PD     %2.3f", Y_PD);
	paint_text_xy( 350, 90, str );
	xsprintf( str, "PD_Y_SM     %2.3f", PD_Y_SM );
	paint_text_xy( 350, 110, str );
#endif
	//fd_dsp_paint_digit( xn, hal_paint_screen_height()-30, tmpfA1 ); //only snr
	//fd_dsp_paint_digit( xn, hal_paint_screen_height()-30, tmpfA0 );

//	xsprintf( str, "rssi1:" );
//	xn = paint_text_xy( 12, hal_paint_screen_height()-22, str );
//	fd_dsp_paint_digit( xn, hal_paint_screen_height()-22, tmpfA1 );

//	paint_color( COLOR_WHITE);
//	xsprintf( str, "%uFD     dft%u    vec%c",
//			pfd_settings->fd_num,
//			pfd_settings->dft_mode,
//			( pfd_settings->vector_mode == 0 ) ? '1' :
//			( pfd_settings->vector_mode == 1 ) ? 'Y' : 'P' );
//	xsprintf( str, "PID%u    dft%u   CLB%u",
//			set_PID_on,
//			pfd_settings->dft_mode, calibration );

}

void fd_dsp_draw_init( fd_data_t *pfd_data )
{
	pfd_data->fd_num = 8;
    pfd_data->buf_size = 1600;
}

void fd_dsp_add_new_vector( fd_data_t *pfd_data )
{
	static BOOL init = FALSE;

    if( init == FALSE )
    {
        init = TRUE;

        for( INT i = 0; i < FD_DSP_TRAIN_DOTS - 1; i++ )
		{
            line_train_x[0][i] = 0;
            line_train_y[0][i] = 0;
            line_train_x[1][i] = 0;
            line_train_y[1][i] = 0;
		}
    }

	// move points from worm ---------------------------------------------------
    for( INT i = 256 -1; i > 0; i-- )
	{
        line_train_x[0][i] = line_train_x[0][i-1];
        line_train_y[0][i] = line_train_y[0][i-1];
        line_train_x[1][i] = line_train_x[1][i-1];
        line_train_y[1][i] = line_train_y[1][i-1];
	}

    // copy new coordinates ----------------------------------------------------
    line_train_x[0][0] = pfd_data->fx[0] + 0;
    line_train_y[0][0] = pfd_data->fy[0] + 0;
    line_train_x[1][0] = pfd_data->fx[1] + 0;
    line_train_y[1][0] = pfd_data->fy[1] + 0;

}

INT calibrate = FD_CLB_STATE_INIT;
static U8 calibrate_state[ FD_CLB_DOTS * 2 ];

void fd_dsp_calibrate_process( fd_data_t *pfd_data, FLOAT *clb )
{
    switch( calibrate )
    {
    case FD_CLB_STATE_INIT: { //init all
        for( INT i = 0; i < FD_CLB_DOTS * 2; i++ )
        {
            calibrate_state[i] = 0;
            // calibrate_buf[i] = 1.0;
            // calibrate_angle[i] = i;
        }
        calibrate = FD_CLB_STATE_NOP;
    } break;

    case FD_CLB_STATE_RESET: {
    } break;

    case FD_CLB_STATE_AFTER_RESET: {
    } break;

    case FD_CLB_STATE_DATA_COLLECT: {
        volatile FLOAT dird;
        volatile U32 tditd;

        // test for precise
        dird = pfd_data->dir[0] * 10.;
        tditd = fabs( dird );
        tditd = tditd % 10;
        //if( tditd <= 1 || tditd >= 9 )
        {
            calibrate_state[ pfd_data->bufpos[0] ] = 1;
            clb[ pfd_data->bufpos[0] ] = 100. / pfd_data->len[0];
            //calibrate_angle[ bufpos ] = dir;
        }

        dird = pfd_data->dir[1] * 10.;
        tditd = fabs( dird );
        tditd = tditd % 10;
        //if( tditd <= 1 || tditd >= 9 )
        {
            calibrate_state[ FD_CLB_DOTS + pfd_data->bufpos[1] ] = 1;
            clb[ pfd_data->bufpos[1] ] = 100. / pfd_data->len[1];
            //calibrate_angle[ bufpos ] = dir;
        }

        // test for ready all dots
        INT all_points_ready = 0;
        INT points_ready_cnt = 0;
        for( INT i = 0; i < FD_CLB_DOTS; i++ )
        {
            if( calibrate_state[ FD_CLB_DOTS + i ] != 0 )
            {
                points_ready_cnt++;
            }
        }
        if( points_ready_cnt >= 360 )
        {
            all_points_ready = 1;
        }
        if( all_points_ready )
        {
            calibrate = FD_CLB_STATE_DATA_COLLECT_OK;
        }
    } break;

    case FD_CLB_STATE_DATA_COLLECT_OK: {
    } break;

    case FD_CLB_STATE_DATA_COLLECT_ERR: {
    } break;

    case FD_CLB_STATE_WAIT_SEND: {
        //nothin...
        //angle = wrap360( angle + 5.0f );
    } break;

    case FD_CLB_STATE_CALIBRATE_WRITE: {

    } break;

    default: break;
    }
}

void fd_dsp_draw_all( fd_data_t *pfd, fd_serial_data_t *pfsd, U32 mode, U32 filter, U32 mul )
{
    static BOOL init = FALSE;
    static COORD center_x = 800/2;
    static COORD center_y = 480/2 + 11;
	static U32 radius = 1;
    static U32 delay_cnt = 0;
    COORD yn;

    if( init == FALSE )
    {
        U32 hue;
        init = TRUE;
        for( INT i = 0; i < DSP_FD_CHANNEL_NUM; i++ )
        {
            hue = ((100 * i) / 4 );
            colors[i] = HSV_to_RGB( hue, 255, 255 );
        }
    }

	// draw x-cross ------------------------------------------------------------
	paint_color( COLOR_BLUE );
	paint_line( center_x, center_y - AREA_SIZE, center_x, center_y + AREA_SIZE );
	paint_line( center_x - AREA_SIZE, center_y, center_x + AREA_SIZE, center_y );

	// draw coord grid ---------------------------------------------------------
	paint_color( COLOR_BLUE + COLOR_GREEN );
	for( COORD j = -(AREA_SIZE); j <= AREA_SIZE; j += GRID_SIZE )
	{
		for( COORD i = -(AREA_SIZE); i <= AREA_SIZE; i += GRID_SIZE )
		{
			paint_pixel( center_x + j, center_y + i );
		}
	}

    // draw points and crosses -------------------------------------------------
    if( mode & 0x01 )
    {
        paint_color( COLOR_LIME );
        for( INT i = 0; i < FD_DSP_TRAIN_DOTS; i++ )
        {
            COORD x1 = line_train_x[0][i] + center_x;
            COORD y1 = line_train_y[0][i] + center_y;
            COORD x2 = line_train_x[0][i+1] + center_x;
            COORD y2 = line_train_y[0][i+1] + center_y;
            paint_line( x1, y1, x2, y2 );
        }
        paint_color( COLOR_LIME );
        COORD x1 = line_train_x[0][0];
        COORD y1 = line_train_y[0][0];
        fd_dsp_paint_vector( center_x, center_y, x1, y1, MARK_SIZE );
    }
    if( mode & 0x02 )
    {
        paint_color( COLOR_YELLOW );
        for( INT i = 0; i < FD_DSP_TRAIN_DOTS; i++ )
        {
            COORD x1 = line_train_x[1][i] + center_x;
            COORD y1 = line_train_y[1][i] + center_y;
            COORD x2 = line_train_x[1][i+1] + center_x;
            COORD y2 = line_train_y[1][i+1] + center_y;
            paint_line( x1, y1, x2, y2 );
        }
        paint_color( COLOR_YELLOW );
        COORD x1 = line_train_x[1][0];
        COORD y1 = line_train_y[1][0];
        fd_dsp_paint_vector( center_x, center_y, x1, y1, MARK_SIZE );
	}

    static U32 v[12];
    static U32 snr[12];

    if( delay_cnt == 0 )
	{
        for( INT i = 0; i < 8; i++ ) //DSP_FD_CHANNEL_NUM
        {
            v[i] = pfd->v[i];
        }

        for( INT i = 0; i < 8; i++ )
        {
            snr[i] = pfd->snr[i];
        }
    }

    if( mode & 0x04 ) //todo
    {
        for( INT i = 0; i < 8; i++ ) //DSP_FD_CHANNEL_NUM
        {
            paint_color( COLOR_RED );
            xsprintf( str, "SNR %1u  %8u", i + 1, v[i] );
            paint_text_xy( 8, 4 + 20 * i, str );
        }
    }
    else
    {
        for( INT i = 0; i < 4; i++ ) //DSP_FD_CHANNEL_NUM
        {
            if( mode & 0x01 )
            {
                paint_color( COLOR_LIME );
            }
            else
                paint_color( COLOR_BLACK );

            xsprintf( str, "CH %1u   %8u", i + 1, v[i] );
            paint_text_xy( 8, 2 + 20 * i, str );
        }
        for( INT i = 4; i < 8; i++ ) //DSP_FD_CHANNEL_NUM
        {
            if( mode & 0x02 )
            {
                paint_color( COLOR_YELLOW );
            }
            else
                paint_color( COLOR_BLACK );

            xsprintf( str, "CH %1u   %8u", i + 1, v[i] );
            paint_text_xy( 8, 4 + 20 * i, str );
        }
    }

    // signal to noise ratio for branches ======================================
    paint_color( COLOR_RED );
    if( snr[1] < 1000 )
    {
        paint_color( COLOR_YELLOW );
    }
    xsprintf( str, "N 1B   %8u", snr[0]);
    paint_text_xy( 610, 100, str );

    paint_color( COLOR_RED );
    if( snr[1] < 1000 )
    {
        paint_color( COLOR_LIME );
    }
    xsprintf( str, "N 2B   %8u", snr[1] );
    yn = 130;
    paint_text_xy( 610, yn, str );


    U32 bnum = 1;//mode & 0x1 ? 0 : 1;

    if( mode & 0x03 )
    {
        //get radius
        FLOAT radiusf = 0;
        for( INT i = 0; i < (FD_DSP_TRAIN_DOTS - 1); i++ )
        {
            FLOAT x, y;
            x = (FLOAT)line_train_x[ bnum ][i];
            y = (FLOAT)line_train_y[ bnum ][i];
            radiusf += sqrtf( x * x + y * y );
        }

        radiusf = radiusf / (FD_DSP_TRAIN_DOTS - 1);
        radius = radiusf;

        //radius = _constrain( radius, 0, AREA_SIZE );

        paint_color( COLOR_BLUE + COLOR_GREEN );
        paint_circle( center_x, center_y, radius, PAINT_QUARTERS_ALL, 0 );

        static U32 _radius;
        if( 0 == delay_cnt )
        {
            _radius = (FLOAT)radius;// / (FLOAT)mul;
        }

        paint_color( COLOR_SKY_BLUE );
        xsprintf( str, "RS    %6u", _radius );
        paint_text_xy( 610, 200, str );

        // roudness computing
        FLOAT roudnessf = 0;
        for( INT i = 0; i < (FD_DSP_TRAIN_DOTS - 2); i++ )
        {
            FLOAT x, y;
            x = (FLOAT)line_train_x[ bnum ][i];
            y = (FLOAT)line_train_y[ bnum ][i];
            roudnessf += fabs( sqrtf( x * x + y * y ) - radiusf );
        }

        U32 roudness = roudnessf / mul;

        static U32 _roudness;
        if( 0 == delay_cnt )
        {
            _roudness = roudness;
        }

        if( _roudness <= 50 )
            paint_color( COLOR_GOLD );
        else
            paint_color( COLOR_SKY_BLUE );

        xsprintf( str, "RNDS  %6u", _roudness );
        paint_text_xy( 610, 230, str );
    }

    // draw calibration line ===================================================
    COORD xw = ((800/2)-FD_CLB_DOTS/2);

    for( INT i = 0; i < FD_CLB_DOTS; i++ )
    {
        COLOR color = COLOR_RED;
        if( calibrate_state[ i ] != 0 )
        {
            color = COLOR_LIME;
        }
        paint_color( color );
        paint_line( xw + i, 480 - 11, xw + i, 480 - 15 );
    }
    // draw line current
    paint_color( COLOR_LIME );
    paint_line( xw + pfd->bufpos[0], 480 - 16, xw + pfd->bufpos[0], 480 - 21 );

    for( INT i = 0; i < FD_CLB_DOTS; i++ )
    {
        COLOR color = COLOR_RED;
        if( calibrate_state[ FD_CLB_DOTS + i ] != 0 )
        {
            color = COLOR_YELLOW;
        }
        paint_color( color );
        paint_line( xw + i, 480 - 1, xw + i, 480 - 5 );
    }
    // draw line current
    paint_color( COLOR_YELLOW );
    paint_line( xw + pfd->bufpos[1], 480 - 6, xw + pfd->bufpos[1], 480 - 10 );

    // polinom get =============================================================
    fd_dsp_polinom( pfd );

    static FLOAT xpd, ypd, xpdsm, ypdsm;
    if( 0 == delay_cnt )
    {
        xpd = pfd->fx[ bnum ];
        ypd = pfd->fy[ bnum ];
        xpdsm = pfd->fpx[ bnum ];
        ypdsm = pfd->fpy[ bnum ];
    }

	paint_color( COLOR_SKY_BLUE );
    xsprintf( str, "X_PD     %2.2f", xpd );
    paint_text_xy( 610, 330, str );
    xsprintf( str, "PD_X_SM  %2.2f", xpdsm );
    paint_text_xy( 610, 350, str );

    paint_color( COLOR_YELLOW );
    xsprintf( str, "Y_PD     %2.2f", ypd );
    paint_text_xy( 610, 390, str );
    xsprintf( str, "PD_Y_SM  %2.2f", ypdsm );
    paint_text_xy( 610, 410, str );

    if( ++delay_cnt > filter )
    {
        delay_cnt = 0;
    }

    //xsprintf( str, "v%u fps:%d mmc:%u", 20240407, 10, 35 ); fps, mavps, fsd.version, fsd.idnum, fsd.inc_cnt
    xsprintf( str, "v%04u id:%u c:%u", pfsd->version, pfsd->idnum, pfsd->inc_cnt );
    paint_color_set( COLOR_WHITE );
    paint_text_xy( 300, 2, str );
}

#include "modGUI.h"
button_t button_calib = { .x = 8, .y = 200, .w =  85, .h = 60, .color = COLOR_ORANGE, .color_pressed = COLOR_BLUE };
button_t button_filt = { .x = 103, .y = 200, .w =  85, .h = 60, .color = COLOR_ORANGE, .color_pressed = COLOR_BLUE };
button_t button_mode  = { .x = 8, .y = 270, .w = 180, .h = 60, .color = COLOR_ORANGE, .color_pressed = COLOR_BLUE };
button_t button_idnum  = { .x = 8, .y = 340, .w = 180, .h = 60, .color = COLOR_ORANGE, .color_pressed = COLOR_BLUE };
button_t button_mul   = { .x = 8, .y = 410, .w = 180, .h = 60, .color = COLOR_ORANGE, .color_pressed = COLOR_BLUE };

extern BOOL touch_has_signal_state;

U32 idnum = 0;

void fd_dsp_buttons_processor( U32 *mode, U32 *filter_mode, U32 *mul )
{
    static INT touched = 0;
    char str[64];
    INT button_calib_state = 0;
    INT button_mode_state = 0;
    INT button_filt_state = 0;
    INT button_idnum_state = 0;
    INT button_mul_state = 0;

    if( fd_dsp_touch_has_signal() )
    {
        if( fd_dsp_touch_touched() && !touched )
        {
            touched = 1;

            button_calib_state = fd_dsp_button_test( &button_calib );
            if( 1 == button_calib_state )
            {
                switch( calibrate )
                {
                case FD_CLB_STATE_INIT: break;
                case FD_CLB_STATE_NOP: calibrate = FD_CLB_STATE_RESET; break;
                case FD_CLB_STATE_RESET: fd_dsp_calibrate_reset(); calibrate = FD_CLB_STATE_AFTER_RESET; break;
                case FD_CLB_STATE_AFTER_RESET: calibrate = FD_CLB_STATE_DATA_COLLECT; break;
                case FD_CLB_STATE_DATA_COLLECT: break;
                case FD_CLB_STATE_DATA_COLLECT_OK: calibrate = FD_CLB_STATE_CALIBRATE_WRITE; break;
                case FD_CLB_STATE_DATA_COLLECT_ERR: calibrate = FD_CLB_STATE_INIT; break;
                //case FD_CLB_STATE_WAIT_SEND: calibrate = FD_CLB_STATE_INIT; break;
                case FD_CLB_STATE_CALIBRATE_WRITE: fd_dsp_calibrate_write(); calibrate = FD_CLB_STATE_INIT; break;
                default: break;
                }
            }

            button_filt_state = fd_dsp_button_test( &button_filt );
            if( 1 == button_filt_state )
            {
                switch( *filter_mode )
                {
                case  1: *filter_mode =  2; break;
                case  2: *filter_mode =  4; break;
                case  4: *filter_mode =  8; break;
                case  8: *filter_mode = 16; break;
                case 16: *filter_mode =  1; break;
                default: *filter_mode =  1; break;
                }
            }

            button_mode_state = fd_dsp_button_test( &button_mode );
            if( 1 == button_mode_state )
            {
                switch( *mode )
                {
                case 1: *mode = 2; break;
                case 2: *mode = 3; break;
                case 3: *mode = 4; break;
                case 4: *mode = 1; break;
                default: *mode = 1; break;
                }
            }

            button_idnum_state = fd_dsp_button_test( &button_idnum );
            if( 1 == button_idnum_state )
            {
                idnum++;
            }

            button_mul_state = fd_dsp_button_test( &button_mul );
            if( 1 == button_mul_state )
            {
                switch( *mul )
                {
                case 1: *mul = 2; break;
                case 2: *mul = 3; break;
                case 3: *mul = 5; break;
                case 5: *mul = 7; break;
                case 7: *mul = 10; break;
                case 10: *mul = 1; break;
                default: *mul = 1; break;
                }
            }
        }
        else if( fd_dsp_touch_released() )
        {
            touched = 0;
        }
    }

    xsprintf( str, "%s",
        calibrate == FD_CLB_STATE_INIT ? "CLBI" :
        calibrate == FD_CLB_STATE_NOP ? "CLBN" :
        calibrate == FD_CLB_STATE_RESET ? "CLBR" :
        calibrate == FD_CLB_STATE_AFTER_RESET ? "CLBAR" :
        calibrate == FD_CLB_STATE_DATA_COLLECT ? "CLB C" :
        calibrate == FD_CLB_STATE_DATA_COLLECT_OK ? "CLB OK" :
        calibrate == FD_CLB_STATE_DATA_COLLECT_ERR ? "CLBERR" :
        //calibrate == FD_CLB_STATE_WAIT_SEND ? "CLBWS" :
        calibrate == FD_CLB_STATE_CALIBRATE_WRITE ? "CLBWR" :
        "ERR" );
    modGUI_button_draw( &button_calib, button_calib_state, str );

    xsprintf( str, "FLT %u", *filter_mode );
    modGUI_button_draw( &button_filt, button_filt_state, str );

    xsprintf( str, "%s",
        *mode == 1 ? "1K only" :
        *mode == 2 ? "2K only" :
        *mode == 3 ? "1K+2K" :
        *mode == 4 ? "SNR" :
        "OFF" );
    modGUI_button_draw( &button_mode, button_mode_state, str );

    xsprintf( str, "id: %u", idnum );
    modGUI_button_draw( &button_idnum, button_idnum_state, str );

    xsprintf( str, "MUL * %u", *mul );
    modGUI_button_draw( &button_mul, button_mul_state, str );
}

#endif

INT fd_dsp_polinom( fd_data_t *pdf )
{
	INT ret = 0;

    for( INT i = 0; i < 2; i++ )
    {
        FLOAT X_PD, Y_PD;

        FLOAT PD_9  = pdf->v[ i*4 + 0 ];
        FLOAT PD_10 = pdf->v[ i*4 + 1 ];
        FLOAT PD_11 = pdf->v[ i*4 + 2 ];
        FLOAT PD_12 = pdf->v[ i*4 + 3 ];

        FLOAT PD_SUM = PD_9 + PD_10 + PD_11 + PD_12;

        if( PD_SUM > 0.0 ) //~= 0 )
        {
            X_PD = ((PD_9 + PD_10) - (PD_12 + PD_11)) / PD_SUM;
            Y_PD = ((PD_9 + PD_12) - (PD_10 + PD_11)) / PD_SUM;
        }
        else
        {
            X_PD =  0.01;
            Y_PD = -0.01;
            //--gcs:send_text(0, "PD default values used")
            ret = -1;
        }

        FLOAT Y_PD_NA = _abs(Y_PD);

        FLOAT X_PD_NA = _abs(X_PD);

        FLOAT PD_X_SM = (24.3168 * Y_PD_NA * Y_PD_NA * Y_PD_NA - 17.23716 * Y_PD_NA * Y_PD_NA + 11.34996 * Y_PD_NA) * _sign(Y_PD);

        FLOAT PD_Y_SM = (24.3168 * X_PD_NA * X_PD_NA * X_PD_NA - 17.23716 * X_PD_NA * X_PD_NA + 11.34996 * X_PD_NA) * _sign(X_PD);

        pdf->fx[i] = X_PD_NA;
        pdf->fy[i] = Y_PD_NA;

        pdf->fpx[i] = PD_X_SM;
        pdf->fpy[i] = PD_Y_SM;
    }

	return ret;
}

#ifndef UART_PROTOCOL_MAVLINK

INT fd_dsp_tx_packet( U8 *buf, fd_data_t *pfd, U8 calibrated )
{
    INT i, size = 0;
    U32 n = 0;

    fd_serial_data_t *pfsd = (fd_serial_data_t *)&buf[0];

    pfsd->version = BUILD_MONTH * 100 + BUILD_DAY;
    pfsd->calibrated = calibrated;
    pfsd->error_code = RET_OK;
    pfsd->ch_num = DSP_FD_CHANNEL_NUM;
    pfsd->branches_num = 2;
    pfsd->vector_mode = 0;
    pfsd->inc_cnt = pfsd->inc_cnt + 1;

    size = 4;
    n = 4;
    U16 *pv = (U16 *)&buf[n]; //4-th byte

    for( i = 0; i < pfsd->ch_num; i++ )
    {
        pv[ i ] = _constrain( pfd->v[ i + 4 ], 0, 65535 );
        size += sizeof(U16);
        n += sizeof(U16);
    }

    for( i = 0; i < pfsd->ch_num; i++ )
    {
        pv[ i + 4 ] = _constrain( pfd->v[ i ], 0, 65535 );
        size += sizeof(U16);
        n += sizeof(U16);
    }

    U16 *psnr = (U16 *)&buf[n];
    for( i = 0; i < pfsd->ch_num * pfsd->branches_num; i++ )
    {
        psnr[i] = _constrain( pfd->snr[ i ], 0, 65535 );
        size += sizeof(U16);
        n += sizeof(U16);
    }

    //fd_dsp_polinom( pfd ); // after calibration - signal coordinates

    //    FLOAT *pfx = (FLOAT *)&buf[n];
    //    for( i = 0; i < 2; i++ )
    //    {
    //        pfx[i] = pfd->fx[ i ];
    //        size += sizeof(FLOAT);
    //        n += sizeof(FLOAT);
    //    }
    //
    //    FLOAT *pfy = (FLOAT *)&buf[n];
    //    for( i = 0; i < 2; i++ )
    //    {
    //        pfy[i] = pfd->fy[ i ];
    //        size += sizeof(FLOAT);
    //        n += sizeof(FLOAT);
    //    }

    return size;
}

INT fd_dsp_rx_packet( U8 *buf, fd_serial_data_t *pfsd, fd_data_t *pfd )
{
	INT i, ret = 0;
	U32 n = 0;
	static U8 inc_cnt = 0;
	INT size = 0;

	fd_serial_data_t *pfsdl = (fd_serial_data_t*)&buf[0];

	*pfsd = *pfsdl;

	if( RET_OK != pfsd->error_code )
	{
		ret = 1;
	}

	if( 0 == pfsd->ch_num )
	{
		ret = 1;
	}

	if( 0 == pfsd->branches_num )
	{
		ret = 1;
	}

	// test for increment number
	if(( pfsd->inc_cnt - 1 ) != inc_cnt )
	{
        //ret = 1;
	}
	inc_cnt = pfsd->inc_cnt;

	size = 4;
	n = 4;
    U16 *pv = (U16 *)&buf[n]; //4-th byte

	for( i = 0; i < pfsd->ch_num * pfsd->branches_num; i++ )
	{
        pfd->v[ i ] = pv[ i ];
        size += sizeof(U16);
		n += sizeof(U16);
	}

    U16 *psnr = (U16 *)&buf[n];
    for( i = 0; i < pfsd->ch_num * pfsd->branches_num; i++ )
	{
        pfd->snr[ i ] = psnr[ i ];
        size += sizeof(U16);
		n += sizeof(U16);
	}

//    FLOAT *pFx = (FLOAT *)&buf[n];
//    for( i = 0; i < 2; i++ )
//    {
//        pfd->fpx[i] = pFx[0];
//        size += sizeof(FLOAT);
//        n += sizeof(FLOAT);
//    }
//
//    FLOAT *pFy = (FLOAT *)&buf[n];
//    for( i = 0; i < 2; i++ )
//    {
//        pfd->fpy[i] = pFy[0];
//        size += sizeof(FLOAT);
//        n += sizeof(FLOAT);
//    }

	return ret;
}

#else

INT fd_dsp_calibrate_tx_packet( U8 *buf, fd_data_t *pfd, U8 calibrated )
{
    INT i, size = 0;
    U32 n = 0;

    fd_serial_data_t *pfsd = (fd_serial_data_t *)&buf[0];

    pfsd->version = BUILD_MONTH * 100 + BUILD_DAY;
    pfsd->calibrated = calibrated;
    pfsd->error_code = RET_OK;
    pfsd->ch_num = DSP_FD_CHANNEL_NUM;
    pfsd->branches_num = 2;
    pfsd->vector_mode = 0;
    pfsd->inc_cnt = pfsd->inc_cnt + 1;

    size = 4;
    n = 4;
    U16 *pv = (U16 *)&buf[n]; //4-th byte

    for( i = 0; i < pfsd->ch_num; i++ )
    {
        pv[ i ] = _constrain( pfd->v[ i + 4 ], 0, 65535 );
        size += sizeof(U16);
        n += sizeof(U16);
    }

    return size;
}

#endif



void fd_dsp_test( void )
{
    //16KHz sempl
    static const U16 ADC_buf[ 1502 ]  = { 2018, 2075, 2075, 2072, 2069, 2066, 2023, 2022, 2024, 2026, 2028, 2028, 2028,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 2072, 2048 };

    fd_data_t fd_data;
    U32 tic;
    S32 tmpS32;

#ifdef STM32
    __disable_irq();
#endif

    //dc remove filter init

    //	fd_settings.fd_num = 3;
    //	fd_settings.dft_mode = 1;
    //	fd_settings.vector_mode = 1;
    //	fd_settings.buf_size = 1500;

    fd_dsp_frq_set( 0, 1209.0 );
    fd_dsp_sample_rate_set( 16000 );//DSP_FD_SAMPLING_RATE );
    fd_dsp_buf_size_set( 500 );//DSP_FD_BUF_SIZE );
    //fd_dsp_mashtab_set( 6 );
    fd_dsp_init(); //init


    for( INT i = 0; i < 5; i++ )
    {
        RESET_CORE_COUNT;
        fd_dsp_process_v1( (U16*)&ADC_buf[0], &fd_data );
        tic = GET_CORE_COUNT;

        //		RESET_CORE_COUNT;
        //		dsp_fd_process_v3( (U16*)&ADC_buf[0], &fd_level );
        //		tic = GET_CORE_COUNT;

        //test_param( fd_level.v[0][0] < 5 );//!= 495 );

        RESET_CORE_COUNT;
        fd_dsp_vector_get( &fd_data, 100 );
        tic = GET_CORE_COUNT;
    }
    (void)tic;

#ifdef STM32
    __enable_irq();
#endif
}
